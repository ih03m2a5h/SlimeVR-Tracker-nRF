## boards/fitra-aaa/Kconfig.fitra-aaa
```kconfig
# Copyright (c) 2024 Nordic Semiconductor ASA
# Copyright (c) 2025 Hitohira.
# SPDX-License-Identifier: Apache-2.0

config BOARD_FITRA_AAA
	select SOC_NRF54L15_CPUAPP if BOARD_FITRA_AAA_NRF54L15_CPUAPP
	select SOC_NRF54L15_CPUFLPR if BOARD_FITRA_AAA_NRF54L15_CPUFLPR || \
					    BOARD_FITRA_AAA_NRF54L15_CPUFLPR_XIP
```

## boards/fitra-aaa/board.yml
```yaml
board:
  name: fitra-aaa
  full_name: FITRA-AAA
  vendor: hitohira
  socs:
    - name: nrf54l15
      variants:
        - name: xip
          cpucluster: cpuflpr
runners:
  run_once:
    '--recover':
      - runners:
          - nrfjprog
          - nrfutil
        run: first
        groups:
          - boards:
              - fitra-aaa/nrf54l15/cpuapp
              - fitra-aaa/nrf54l15/cpuflpr
              - fitra-aaa/nrf54l15/cpuflpr/xip
    '--erase':
      - runners:
          - nrfjprog
          - jlink
          - nrfutil
        run: first
        groups:
          - boards:
              - fitra-aaa/nrf54l15/cpuapp
              - fitra-aaa/nrf54l15/cpuflpr
              - fitra-aaa/nrf54l15/cpuflpr/xip
    '--reset':
      - runners:
          - nrfjprog
          - jlink
          - nrfutil
        run: last
        groups:
          - boards:
              - fitra-aaa/nrf54l15/cpuapp
              - fitra-aaa/nrf54l15/cpuflpr
              - fitra-aaa/nrf54l15/cpuflpr/xip
```

## boards/raytac/an54lq-15/Kconfig.an54lq-15
```kconfig
config BOARD_AN54LQ_15
	select SOC_NRF54L15_CPUAPP if BOARD_AN54LQ_15_NRF54L15_CPUAPP
```

## boards/raytac/an54lq-15/Kconfig.defconfig
```kconfig
config HW_STACK_PROTECTION
	default ARCH_HAS_STACK_PROTECTION

if BOARD_AN54LQ_15_NRF54L15_CPUAPP

config ROM_START_OFFSET
	default 0 if PARTITION_MANAGER_ENABLED
	default 0x800 if BOOTLOADER_MCUBOOT

endif # BOARD_AN54LQ_15_NRF54L15_CPUAPP
```
